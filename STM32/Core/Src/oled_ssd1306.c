#include "oled_ssd1306.h"

/* Global OLED structure */
static OLED_t oled;

/* Simple 5x7 font for ASCII characters 32-126 */
static const uint8_t font_5x7[95][5] = {
    {0x00, 0x00, 0x00, 0x00, 0x00}, /* space */
    {0x00, 0x00, 0x5F, 0x00, 0x00}, /* ! */
    {0x00, 0x07, 0x00, 0x07, 0x00}, /* " */
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    {0x10, 0x08, 0x08, 0x10, 0x08}, /* ~ */
};

/* Send command to OLED */
static HAL_StatusTypeDef OLED_SendCommand(uint8_t cmd)
{
    uint8_t data[2] = {0x00, cmd}; /* Control byte + Command */
    return HAL_I2C_Master_Transmit(oled.i2c, SSD1306_I2C_ADDR, data, 2, 100);
}

/* Send data to OLED */
static HAL_StatusTypeDef OLED_SendData(uint8_t *data, uint16_t size)
{
    uint8_t buffer[129];
    buffer[0] = 0x40; /* Data control byte */
    memcpy(&buffer[1], data, size);
    return HAL_I2C_Master_Transmit(oled.i2c, SSD1306_I2C_ADDR, buffer, size + 1, 100);
}

/* Initialize OLED display */
void OLED_Init(I2C_HandleTypeDef *hi2c)
{
    oled.i2c = hi2c;
    oled.width = SSD1306_WIDTH;
    oled.height = SSD1306_HEIGHT;

    /* Clear buffer */
    memset(oled.buffer, 0, SSD1306_BUFFER_SIZE);

    /* Power down sequence */
    HAL_Delay(100);

    /* Initialize display */
    OLED_SendCommand(0xAE); /* Display OFF */
    OLED_SendCommand(0xD5); /* Set Clock Divide */
    OLED_SendCommand(0x80);
    OLED_SendCommand(0xA8); /* Set Multiplex Ratio */
    OLED_SendCommand(0x3F);
    OLED_SendCommand(0xD3); /* Set Display Offset */
    OLED_SendCommand(0x00);
    OLED_SendCommand(0x40); /* Set Display Start Line */
    OLED_SendCommand(0x8D); /* Charge Pump */
    OLED_SendCommand(0x14);
    OLED_SendCommand(0x20); /* Memory Mode */
    OLED_SendCommand(0x00); /* Horizontal addressing */
    OLED_SendCommand(0xA1); /* Segment remap */
    OLED_SendCommand(0xC8); /* COM Output scan direction */
    OLED_SendCommand(0xDA); /* COM Pins config */
    OLED_SendCommand(0x12);
    OLED_SendCommand(0x81); /* Contrast */
    OLED_SendCommand(0xCF);
    OLED_SendCommand(0xD9); /* Precharge */
    OLED_SendCommand(0xF1);
    OLED_SendCommand(0xDB); /* VCOMH */
    OLED_SendCommand(0x40);
    OLED_SendCommand(0xA6); /* Normal display */
    OLED_SendCommand(0xAF); /* Display ON */

    printf("OLED SSD1306 initialized successfully\r\n");
}

/* Clear OLED display */
void OLED_Clear(void)
{
    memset(oled.buffer, 0, SSD1306_BUFFER_SIZE);
    OLED_Display();
}

/* Display buffer on OLED */
void OLED_Display(void)
{
    for (uint8_t page = 0; page < 8; page++)
    {
        OLED_SendCommand(0xB0 + page); /* Page address */
        OLED_SendCommand(0x00);        /* Lower column */
        OLED_SendCommand(0x10);        /* Upper column */

        OLED_SendData(&oled.buffer[page * 128], 128);
    }
}

/* Set pixel */
void OLED_SetPixel(uint8_t x, uint8_t y, uint8_t state)
{
    if (x >= SSD1306_WIDTH || y >= SSD1306_HEIGHT)
        return;

    uint16_t index = (y / 8) * SSD1306_WIDTH + x;

    if (state)
        oled.buffer[index] |= (1 << (y % 8));
    else
        oled.buffer[index] &= ~(1 << (y % 8));
}

/* Write string at position */
void OLED_WriteString(uint8_t x, uint8_t y, const char *str)
{
    while (*str && x < SSD1306_WIDTH - 5)
    {
        uint8_t char_index = *str - 32;
        if (char_index < 95)
        {
            for (uint8_t i = 0; i < 5; i++)
            {
                uint8_t line = font_5x7[char_index][i];
                for (uint8_t j = 0; j < 8; j++)
                {
                    if (line & (1 << j))
                        OLED_SetPixel(x + i, y + j, 1);
                }
            }
        }
        x += 6;
        str++;
    }
}

/* Write string on line (0-7) */
void OLED_WriteLine(uint8_t line, const char *str)
{
    if (line >= 8)
        return;
    OLED_WriteString(0, line * 8, str);
}

/* Turn display ON */
void OLED_DisplayOn(void)
{
    OLED_SendCommand(0xAF);
}

/* Turn display OFF */
void OLED_DisplayOff(void)
{
    OLED_SendCommand(0xAE);
}

/* Set contrast (0-255) */
void OLED_SetContrast(uint8_t contrast)
{
    OLED_SendCommand(0x81);
    OLED_SendCommand(contrast);
}
